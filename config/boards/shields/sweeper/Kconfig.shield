## config/boards/shields/sweeper/Kconfig.shield
```kconfig
# Copyright (c) 2020 The ZMK Contributors
# SPDX-License-Identifier: MIT

config SHIELD_SWEEPER_LEFT
	def_bool $(shields_list_contains,sweeper_left)

config SHIELD_SWEEPER_RIGHT
	def_bool $(shields_list_contains,sweeper_right)
```
